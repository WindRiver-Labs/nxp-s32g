## conf/layer.conf
```bitbake
#
# Copyright (C) 2020 Wind River Systems, Inc.
#

# We have a conf and classes directory, add to BBPATH
BBPATH =. "${LAYERDIR}:"

# We have a packages directory, add to BBFILES
BBFILES += "${LAYERDIR}/recipes-*/*/*.bb \
	${LAYERDIR}/recipes-*/*/*.bbappend \
	${LAYERDIR}/classes/*.bbclass"

BBFILE_COLLECTIONS += "wr-nxp-s32g"
BBFILE_PATTERN_wr-nxp-s32g= "^${LAYERDIR}/"
BBFILE_PRIORITY_wr-nxp-s32g = "7"

# This should only be incremented on significant changes that will
# cause compatibility issues with other layers
LAYERVERSION_wr-nxp-s32g = "1"

LAYERDEPENDS_wr-nxp-s32g = "core wrlinux"
LAYERSERIES_COMPAT_wr-nxp-s32g = "wrl hardknott"

LAYERRECOMMENDS_wr-nxp-s32g = "nxp-s32g-dl"
NON_MULTILIB_RECIPES_append = " u-boot-s32"
NON_MULTILIB_RECIPES_append = " atf-s32g"

# We have a pre-populated downloads directory, add to PREMIRRORS
PREMIRRORS_append = " \
     .*://.*/.* file://${LAYERDIR}/downloads/ \n \
     git://.*/.* git://${LAYERDIR}/git/MIRRORNAME;protocol=file \n \
"
```

## conf/machine/include/ipcf.inc
```bitbake
IPCF_M7_APP_BIN_DIR ?= "."
IPCF_M7_APP_BIN_NAME ?= "IPCF_Example_S32G274_M7_0.bin"
IPCF_M7_APP_BIN_NAME_S32G3 ?= "IPCF_Example_S32G399_M7_0.bin"
```

## conf/machine/include/llce.inc
```bitbake
FW_ROOTFS_DIR = "lib/firmware"
FW_INSTALL_DIR = "${D}/${FW_ROOTFS_DIR}"

FW_INSTALL_DTE_NAME ?= "dte.bin"
FW_INSTALL_FRPE_NAME ?= "frpe.bin"
FW_INSTALL_PPE-TX_NAME ?= "ppe_tx.bin"
FW_INSTALL_PPE-RX_NAME ?= "ppe_rx.bin"
LLCE_FW_BIN_LIST ?= "${FW_INSTALL_DTE_NAME} ${FW_INSTALL_FRPE_NAME} ${FW_INSTALL_PPE-TX_NAME} ${FW_INSTALL_PPE-RX_NAME}"
LLCE_LOCAL_FIRMWARE_DIR ?= "."
LLCE_LOCAL_FIRMWARE_DIR_S32G3 ?= "."

#LLCE_FW_S32G3 is the dir name of S32G3 firmwares in build deploy path
LLCE_FW_S32G2 ?= "llce_fw_s32g2"
LLCE_FW_S32G3 ?= "llce_fw_s32g3"
```

## conf/machine/nxp-s32g2xx.conf
```bitbake
#@TYPE: Machine
#@NAME: nxp-s32g2xx
#@DESCRIPTION: Machine configuration for NXP S32G274A SoC

DEFAULTTUNE = "cortexa53"
require conf/machine/include/tune-cortexa53.inc

MACHINE_FEATURES = "ext3 pci usbgadget usbhost vfat"

KERNEL_IMAGETYPE = ""
KERNEL_IMAGETYPES = " ${@bb.utils.contains('UBOOT_SIGN_ENABLE', '1', 'fitImage', 'Image.gz Image', d)}"
KERNEL_DEVICETREE = "freescale/fsl-s32g274a-evb.dtb \
                     ${@bb.utils.contains('UBOOT_SIGN_ENABLE', '1', '', 'freescale/fsl-s32g274a-rdb2.dtb', d)} \
"

SERIAL_CONSOLES ?= "115200;ttyLF0"
SERIAL_CONSOLES_CHECK ?= "${SERIAL_CONSOLES}"

IMAGE_FSTYPES += "tar.bz2"

# multilib support
MULTILIBS ?= "multilib:lib32"
DEFAULTTUNE_virtclass-multilib-lib32 ?= "armv7athf-neon"
EXTRA_IMAGECMD_jffs2 = "--pad --no-cleanmarkers --eraseblock=128"

UBOOT_CONFIG ??= "s32g274ardb2 s32g274aevb"

S32G274AEVB_UBOOT_DEFCONFIG_NAME = "${@bb.utils.contains('UBOOT_SIGN_ENABLE', '1', 's32g274aevb_defconfig', 's32g2xxaevb_defconfig', d)}"
S32G274ARDB2_UBOOT_DEFCONFIG_NAME = "${@bb.utils.contains('UBOOT_SIGN_ENABLE', '1', '', 's32g274ardb2_defconfig', d)}"
UBOOT_CONFIG[s32g274aevb] = "${S32G274AEVB_UBOOT_DEFCONFIG_NAME}"
UBOOT_CONFIG[s32g274ardb2] = "${S32G274ARDB2_UBOOT_DEFCONFIG_NAME}"

UBOOT_MAKE_TARGET ?= "u-boot.s32"
UBOOT_BINARY = "u-boot.s32"
PREFERRED_VERSION_u-boot-s32 ?= "2020.04"
PREFERRED_PROVIDER_virtual/bootloader = "u-boot-s32"
MULTI_PROVIDER_WHITELIST += "virtual/bootloader"

WIC_CREATE_EXTRA_ARGS = "--no-fstab-update"
MACHINE_EXTRA_RRECOMMENDS = " kernel-modules kernel-devicetree"
IMAGE_FSTYPES += "tar.bz2 wic wic.bmap"
WKS_FILE ?= "s32g2xx-sdimage-bootpart.wks"
IMAGE_INSTALL_append = " ${@bb.utils.contains('UBOOT_SIGN_ENABLE', '1', 'kernel-devicetree kernel-image-fitimage', 'kernel-devicetree kernel-image-image', d)}"
do_image_wic[depends] += "mtools-native:do_populate_sysroot dosfstools-native:do_populate_sysroot"
IMAGE_BOOT_FILES ?= " ${@bb.utils.contains('UBOOT_SIGN_ENABLE', '1', 'fitImage', 'Image fsl-s32g274a-evb.dtb fsl-s32g274a-rdb2.dtb', d)}"
IMAGE_BOOT_FILES_append = " ${@bb.utils.contains('IMAGE_INSTALL', 'pfe', 's32g_pfe_class.fw s32g_pfe_util.fw', '', d)}"

# Enable ATF
require conf/machine/include/atf.inc
PREFERRED_PROVIDER_virtual/atf-s32g ?= " ${@bb.utils.contains('ATF_S32G_ENABLE', '1', 'atf-s32g', '', d)}"
PREFERRED_PROVIDER_virtual/kernel ??= "linux-yocto"
PREFERRED_VERSION_linux-yocto ?= "5.10%"

# For ostree
INITRAMFS_IMAGE ??= ""
IMAGE_BOOT_FILES_append =  "${@bb.utils.contains('DISTRO_FEATURES', 'ostree', '${INITRAMFS_IMAGE}-${MACHINE}.${INITRAMFS_FSTYPES};initramfs boot.scr', '', d)} \
"
OSTREE_KERNEL ?= "Image"
DEFAULT_DTB ?= "fsl-s32g274a-rdb2.dtb"
OSTREE_COPY_IMAGE_BOOT_FILES = "1"
OSTREE_UBOOT_CMD ?= "booti"

# For ustart.img
OSTREE_NETINST_DEV ?= "/dev/mmcblk0,/dev/sda,/dev/vda"
OSTREE_NETINST_ARGS ?= "${OSTREE_CONSOLE} bl=ufsd rdinit=/install instdev=${OSTREE_NETINST_DEV} instname=wrlinux instbr=\$BRANCH insturl=\$URL instab=${OSTREE_USE_AB} instsf=1 instdate=BUILD_DATE"
```

## s32g-secure-boot/conf/layer.conf
```bitbake
#
# Copyright (C) 2020 Wind River Systems, Inc.
#

# We have a conf and classes directory, add to BBPATH
BBPATH .= ":${LAYERDIR}"

require s32g-secure-boot.inc

# We have a packages directory, add to BBFILES
BBFILES += "${LAYERDIR}/recipes-*/*/*.bb \
	${LAYERDIR}/recipes-*/*/*.bbappend \
	${LAYERDIR}/classes/*.bbclass"

BBFILE_COLLECTIONS += "s32g-secure-layer"
BBFILE_PATTERN_s32g-secure-layer := "^${LAYERDIR}/"
BBFILE_PRIORITY_s32g-secure-layer = "7"

INSECURE_KEY_MSG = "\
WARNING: The insecure sample keys are used for secure Boot.\
Please ensure that you are aware of what your risk to use these keys in your own product."

# Warn the user if sample key is used
BANNER[nxp-s32g_default] = "${INSECURE_KEY_MSG}"

LAYERSERIES_COMPAT_s32g-secure-layer = "wrl hardknott"

LAYER_PATH_s32g-secure-layer = "${LAYERDIR}"

LAYERDEPENDS_s32g-secure-layer = "wr-nxp-s32g"
```

## wic/s32g2xx-sdimage-bootpart.wks
```
# short-description: Create SD card image with a boot partition
# long-description: Creates a partitioned SD card image. Boot files
# are located in the first vfat partition.
part /boot --source bootimg-partition --ondisk mmcblk1 --fstype=vfat --label boot --active --align 10240 --size 64
part / --source rootfs --ondisk mmcblk1 --fstype=ext4 --label root --align 4096
```
